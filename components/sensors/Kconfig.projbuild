## components/sensors/Kconfig.projbuild
```kconfig
menu "Sensors Configuration"
    config SENSORS_DHT22_SLEEP_PERIOD
        int "DHT22: Sleep time (min)"
        default 10
        help
            Time in minutes between measurement of DHT22.

    config SENSORS_DHT22_PIN
        int "DHT22: Digital pin"
        default 19
        help
            Time in minutes between measurement of DHT22.

    config SENSORS_SDS011_SLEEP_PERIOD
        int "SDS011: Sleep time (min)"
        default 10
        help
            Time in minutes between measurement of SDS011.

    config SENSORS_SDS011_WARM_UP
        int "SDS011: Warm up time (seconds)"
        default 60
        help
            Time in minutes between measurement of SDS011.

    config SENSORS_SDS011_MEASUREMENT_BULK_SIZE
        int "SDS011: Number of measurements in bulk"
        default 10
        help
            Average value of bulk measurements are reported to the cloud.

    config SENSORS_SDS011_MEASUREMENT_BULK_SLEEP
        int "SDS011: Sleep time in seconds between bulk measurements"
        default 5
        help
            Sleep time between measurements inside the bulk.
endmenu
```

## components/sync/Kconfig.projbuild
```kconfig
menu "Sync Configuration"
    config SYNC_PERIOD
        int "SYNC: Synchronization period (min)"
        default 5
        help
            Synchronization period length.
endmenu
```
